## boards/shields/sofle/Kconfig.shield
```kconfig
# SPDX-License-Identifier: MIT
config SHIELD_SOFLE
    bool "Sofle"
    depends on SHIELD
    select ZMK_DISPLAY
    select SSD1306
    select ZMK_SPLIT
    help
      Enable support for Sofle keyboard shield with OLED.
```
