/ {
    chosen { zmk,display = &oled; };
};

/* Use the Pro Micro I2C bus alias provided by nice_nano_v2.
 * We do NOT override SDA/SCL pins here; the board already sets them correctly.
 */
&pro_micro_i2c {
    status = "okay";

    oled: ssd1306@3c {
        compatible = "solomon,ssd1306fb";
        reg = <0x3c>;      /* change to 0x3d if you move the module’s ADDR pad */
        label = "SSD1306";
        width = <128>;
        height = <32>;     /* set <64> if your modules are 128x64 */
    };
};
